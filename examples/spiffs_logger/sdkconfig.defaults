## examples/spiffs_logger/sdkconfig.defaults
```kconfig
# Use the custom partitions.csv so the example's "storage" SPIFFS partition exists.
CONFIG_PARTITION_TABLE_CUSTOM=y
CONFIG_PARTITION_TABLE_CUSTOM_FILENAME="partitions.csv"
```
